void mousePressed() {
  if (mouseButton==RIGHT){
    MFtype=0;
    for(int i =0; i < 5; i ++)
    GainAdjust_b[i].activated = false;
  }
  if (mouseButton==RIGHT && rmouseX < 1370) {
    MFtype=0;
    mouseWheeling = false;
    for (int i =0; i < 10; i ++)
      shapes2_b[i].activated = false;
  }
  Sleeping = false;
  sleepingTimer =0;

  ///////////////////////////////////////////////////////////////////////////////////////////////////////////////////////////////////////////
  ///////////////////////////////////////////////////////////////////////////////////////////////////////////////////////////////////////////

  MainInterfaceMousePressed();

  if (face==1) {
    Interface1MousePressed();
  } else if (face==2) {
    Interface2MousePressed();
  } else if (face ==3 && !UART_b.activated) {
    Interface3MousePressed();
  }else if (face ==4) {
    Interface4MousePressed();
  }



  ///////////////////////////////////////////////////////////////////////////////////////////////////////////////////////////////////////////
  ///////////////////////////////////////////////////////////////////////////////////////////////////////////////////////////////////////////
}
